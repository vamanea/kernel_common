## backports/Kconfig
```kconfig
config BACKPORT_INTEGRATE
	bool
	def_bool y

config BACKPORT_DIR
	string
	default "backports"

config BACKPORT_VERSION
	string
	default "v4.14-rc2-1-35-g3d13478f"

config BACKPORT_KERNEL_VERSION
	string
	default "v4.14-0-gbebc6082da0a"

config BACKPORT_KERNEL_NAME
	string
	default "Linux"

menuconfig BACKPORT_LINUX
	bool "Backport Linux v4.14-0-gbebc6082da0a (backports v4.14-rc2-1-35-g3d13478f)"
	default n
	---help---
	  Enabling this will let give you the opportunity to use features and
	  drivers backported from Linux v4.14-0-gbebc6082da0a
	  on the kernel your are using. This is experimental and you should
	  say no unless you'd like to help test things or want to help debug
	  this should we run into any issues.

if BACKPORT_LINUX

source "$BACKPORT_DIR/Kconfig.versions"
source "$BACKPORT_DIR/Kconfig.sources"
# source "$BACKPORT_DIR/Kconfig.local"

endif # BACKPORT_LINUX
```
